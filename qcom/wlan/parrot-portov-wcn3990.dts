/dts-v1/;
/plugin/;

#include "parrot-wcn3990.dtsi"

/ {
	model = "portov";
	compatible = "qcom,parrot", "qcom,parrot-qrd", "qcom,qrd", "moto,portov";
	qcom,msm-id = <613 0x10000>;
	qcom,board-id = <0x46 0x9000>, <0x46 0xB100>, <0x47 0xB100>;
};
