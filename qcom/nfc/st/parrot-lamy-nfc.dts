/dts-v1/;
/plugin/;

#include "parrot-mona-nfc-overlay.dtsi"

/ {
	model = "lamy";
	compatible = "qcom,parrot", "qcom,parrot-qrd", "qcom,qrd", "moto,lamy";
	qcom,msm-id = <663 0x10000>;
	qcom,board-id = <0x42 0x9000>;
};